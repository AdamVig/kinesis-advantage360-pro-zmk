td0: tap_dance_0 {
     compatible = "zmk,behavior-tap-dance";
     label = "TAP_DANCE_0";
     #binding-cells = <0>;
     tapping-term-ms = <200>;
     bindings = <&mo 2>, <&kp RIGHT_ALT>;
};
macro_audioswap: macro_audioswap{
     compatible = "zmk,behavior-macro";
     label = "macro_audioswap";
     #binding-cells = <0>;
     bindings = <&kp LC(LS(LA(LG(F12))))>;
};
